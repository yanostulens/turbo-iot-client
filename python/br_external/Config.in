## python/br_external/Config.in
```kconfig
source "$BR2_EXTERNAL_nit_PATH/package/nit-sensors/Config.in"
source "$BR2_EXTERNAL_nit_PATH/package/turbo-iot-client/Config.in"
```

## python/br_external/configs/nit_beaglebone_defconfig
```kconfig
BR2_arm=y
BR2_cortex_a8=y
BR2_ARM_FPU_VFPV3=y
BR2_ENABLE_DEBUG=y
BR2_DEBUG_3=y
BR2_GLOBAL_PATCH_DIR="board/beaglebone/patches"
BR2_TOOLCHAIN_BUILDROOT_GLIBC=y
BR2_KERNEL_HEADERS_CUSTOM_TARBALL=y
BR2_KERNEL_HEADERS_CUSTOM_TARBALL_LOCATION="$(call github,beagleboard,linux,5.10.30-ti-r3)/linux-5.10.30-ti-r3.tar.gz"
BR2_PACKAGE_HOST_LINUX_HEADERS_CUSTOM_5_10=y
BR2_TOOLCHAIN_BUILDROOT_CXX=y
BR2_TARGET_GENERIC_HOSTNAME="beagle"
BR2_ROOTFS_DEVICE_CREATION_DYNAMIC_MDEV=y
BR2_TARGET_GENERIC_ROOT_PASSWD="root"
BR2_SYSTEM_BIN_SH_BASH=y
BR2_TARGET_GENERIC_GETTY_PORT="ttyS0"
BR2_ROOTFS_OVERLAY="$(BR2_EXTERNAL_nit_PATH)/board/nit/beaglebone/rootfs_overlay"
BR2_ROOTFS_POST_BUILD_SCRIPT="board/beaglebone/post-build.sh"
BR2_ROOTFS_POST_IMAGE_SCRIPT="support/scripts/genimage.sh"
BR2_ROOTFS_POST_SCRIPT_ARGS="-c board/beaglebone/genimage.cfg"
BR2_LINUX_KERNEL=y
BR2_LINUX_KERNEL_CUSTOM_TARBALL=y
BR2_LINUX_KERNEL_CUSTOM_TARBALL_LOCATION="$(call github,beagleboard,linux,5.10.30-ti-r3)/linux-5.10.30-ti-r3.tar.gz"
BR2_LINUX_KERNEL_USE_CUSTOM_CONFIG=y
BR2_LINUX_KERNEL_CUSTOM_CONFIG_FILE="$(BR2_EXTERNAL_nit_PATH)/board/nit/beaglebone/nit_beaglebone_linux_defconfig"
BR2_LINUX_KERNEL_DTS_SUPPORT=y
BR2_LINUX_KERNEL_INTREE_DTS_NAME="am335x-evm am335x-bone am335x-boneblack am335x-bonegreen am335x-evmsk am335x-boneblue am335x-boneblack-wireless"
BR2_LINUX_KERNEL_CUSTOM_DTS_PATH="$(BR2_EXTERNAL_nit_PATH)/board/nit/beaglebone/am335x-bonegreen.dts"
BR2_LINUX_KERNEL_NEEDS_HOST_OPENSSL=y
BR2_PACKAGE_BUSYBOX_SHOW_OTHERS=y
BR2_PACKAGE_ZIP=y
BR2_PACKAGE_GDB=y
BR2_PACKAGE_GDB_DEBUGGER=y
BR2_PACKAGE_PYTHON3=y
BR2_PACKAGE_ZLIB_NG=y
BR2_PACKAGE_CZMQ=y
BR2_PACKAGE_LIBCURL=y
BR2_PACKAGE_LIBCURL_TLS_NONE=y
BR2_PACKAGE_IPROUTE2=y
BR2_PACKAGE_LIGHTTPD=y
BR2_PACKAGE_NETCAT=y
BR2_PACKAGE_OPENSSH=y
BR2_TARGET_ROOTFS_EXT2=y
BR2_TARGET_ROOTFS_EXT2_4=y
BR2_TARGET_UBOOT=y
BR2_TARGET_UBOOT_BUILD_SYSTEM_KCONFIG=y
BR2_TARGET_UBOOT_CUSTOM_VERSION=y
BR2_TARGET_UBOOT_CUSTOM_VERSION_VALUE="2021.04"
BR2_TARGET_UBOOT_BOARD_DEFCONFIG="am335x_evm"
BR2_TARGET_UBOOT_NEEDS_DTC=y
# BR2_TARGET_UBOOT_FORMAT_BIN is not set
BR2_TARGET_UBOOT_FORMAT_IMG=y
BR2_TARGET_UBOOT_SPL=y
BR2_TARGET_UBOOT_SPL_NAME="MLO"
BR2_PACKAGE_HOST_DOSFSTOOLS=y
BR2_PACKAGE_HOST_GENIMAGE=y
BR2_PACKAGE_HOST_MTOOLS=y
BR2_PACKAGE_HOST_PYTHON3=y
BR2_PACKAGE_HOST_UBOOT_TOOLS=y
BR2_PACKAGE_HOST_UBOOT_TOOLS_FIT_SUPPORT=y
BR2_PACKAGE_HOST_ZIP=y
BR2_PACKAGE_NIT_SENSORS=y
BR2_PACKAGE_TURBO_IOT_CLIENT=y
```

## python/br_external/package/cpp-sensors/Config.in
```kconfig
config BR2_PACKAGE_CPP_SENSORS
    bool "cpp-sensors"
    select BR2_PACKAGE_LIBGPIOD
    help
        Drivers for the nit-sensors written in cpp
```

## python/br_external/package/nit-sensors/Config.in
```kconfig
config BR2_PACKAGE_NIT_SENSORS
    bool "nit-sensors"
    select BR2_PACKAGE_LIBGPIOD
    help
        Microbus sensor drivers for nit embedded linux labs.
```

## python/br_external/package/turbo-iot-client/Config.in
```kconfig
config BR2_PACKAGE_TURBO_IOT_CLIENT
        bool "turbo-iot-client"
        depends on BR2_PACKAGE_PYTHON3
        select BR2_PACKAGE_PYTHON_PSUTIL
        select BR2_PACKAGE_PYTHON_REQUESTS
        help
          Adds the turbo iot client source code to the build
```
